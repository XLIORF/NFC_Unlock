## main/Kconfig.projbuild
```kconfig
menu "Main APP Configuration"

    orsource "$IDF_PATH/examples/common_components/env_caps/$IDF_TARGET/Kconfig.env_caps"

    config I2C_NUM
        int "I2C端口号"
        range ENV_GPIO_RANGE_MIN ENV_GPIO_OUT_RANGE_MAX
        default 0

    config I2C_MASTER_SCL
        int "SCL GPIO Num"
        range ENV_GPIO_RANGE_MIN ENV_GPIO_OUT_RANGE_MAX
        default 1
        help
            GPIO number for I2C Master clock line.

    config I2C_MASTER_SDA
        int "SDA GPIO Num"
        range ENV_GPIO_RANGE_MIN ENV_GPIO_OUT_RANGE_MAX
        default 0
        help
            GPIO number for I2C Master data line.
endmenu


menu "network app Configuration"

    config IPV4
        bool "IPV4"
        default y
        depends on LWIP_IPV4

    config IPV6
        bool "IPV6"
        default n
        select CONNECT_IPV6

    config PORT
        int "Port"
        range 0 65535
        default 3333
        help
            Local port the example server will listen on.

    config KEEPALIVE_IDLE
        int "TCP keep-alive idle time(s)"
        default 5
        help
            Keep-alive idle time. In idle time without receiving any data from peer, will send keep-alive probe packet

    config KEEPALIVE_INTERVAL
        int "TCP keep-alive interval time(s)"
        default 5
        help
            Keep-alive probe packet interval time.

    config KEEPALIVE_COUNT
        int "TCP keep-alive packet retry send counts"
        default 3
        help
            Keep-alive probe packet retry count.
endmenu
```
